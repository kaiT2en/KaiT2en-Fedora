## modules/apple-t2-bridge/drivers/platform/x86/apple/Kconfig
```kconfig
# SPDX-License-Identifier: GPL-2.0-only
#
# Apple x86 platform drivers
#

config APPLE_T2_BRIDGE
	tristate "Apple T2 Bridge Controller"
	depends on PCI && X86
	select AUXILIARY_BUS
	help
	  Driver for the Bridge Controller of Intel Macs with a T2 chip. It
	  carries the host traffic to the T2 and is required for the internal
	  keyboard, trackpad, Touch Bar and audio of these machines.

	  To compile this driver as a module, choose M here: the module will
	  be called apple-t2-bridge.
```

## modules/apple-t2-bridge/drivers/usb/host/Kconfig
```kconfig
# SPDX-License-Identifier: GPL-2.0
#
# Fragment of drivers/usb/host/Kconfig

config USB_APPLE_T2_VHCI
	tristate "Apple T2 virtual USB host controller"
	depends on APPLE_T2_BRIDGE
	help
	  The T2 chip of Intel Macs connects keyboard, trackpad, Touch Bar
	  and other internal devices through a virtual USB host controller.

	  To compile this driver as a module, choose M here: the module will
	  be called apple-t2-vhci-hcd.
```

## modules/apple-t2-bridge/sound/pci/apple-t2/Kconfig
```kconfig
# SPDX-License-Identifier: GPL-2.0
#
# Fragment of sound/pci/Kconfig

config SND_APPLE_T2
	tristate "Apple T2 audio"
	depends on APPLE_T2_BRIDGE
	select SND_PCM
	select SND_JACK
	help
	  Say Y here for the speakers, microphones and headphone jack of
	  Intel Macs with a T2 chip.

	  To compile this driver as a module, choose M here: the module will
	  be called snd-apple-t2.
```

## t2-services/t2-ave/kernel/t2-ave/Kconfig
```kconfig
# SPDX-License-Identifier: GPL-2.0
config T2_AVE
	tristate "Apple T2 audio video encoder support"
	depends on APPLE_T2_BRIDGE
	depends on MEDIA_SUPPORT && VIDEO_DEV
	select V4L2_MEM2MEM_DEV
	select VIDEOBUF2_VMALLOC
	help
	  Driver for the Apple T2 video encoder (AVE), exposed as a V4L2
	  memory-to-memory device.

	  If built as a module, it is called t2-ave.
```

## t2-services/t2-ave/kernel/t2-sidecar/Kconfig
```kconfig
# SPDX-License-Identifier: GPL-2.0
config T2_SIDECAR
	tristate "Apple T2 Sidecar video encoder support"
	depends on USB
	depends on MEDIA_SUPPORT && VIDEO_DEV
	select V4L2_MEM2MEM_DEV
	select VIDEOBUF2_VMALLOC
	help
	  Driver for the low-latency H.264/HEVC encoder the Apple T2 offers to
	  Sidecar. The T2 exposes it as a virtual USB device while t2remote
	  holds the com.apple.videoprocessingd.encode.remote connection. It is
	  exposed as a V4L2 memory-to-memory device.

	  If built as a module, it is called t2-sidecar.
```
